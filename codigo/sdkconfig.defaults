## codigo/sdkconfig.defaults
```kconfig
# SDK defaults for SmartFlora
CONFIG_ESPTOOLPY_FLASHSIZE_4MB=y
CONFIG_PARTITION_TABLE_CUSTOM=y
CONFIG_PARTITION_TABLE_CUSTOM_FILENAME="partitions.csv"

# FreeRTOS
CONFIG_FREERTOS_HZ=1000

# MQTT
CONFIG_MQTT_PROTOCOL_311=y

# WiFi
CONFIG_ESP_WIFI_SOFTAP_SUPPORT=y

# HTTP Server (para WiFi provisioning)
CONFIG_HTTPD_MAX_REQ_HDR_LEN=1024

# MBEDTLS para HTTPS (Telegram)
CONFIG_MBEDTLS_CERTIFICATE_BUNDLE=y
CONFIG_MBEDTLS_CERTIFICATE_BUNDLE_DEFAULT_FULL=y
```

## codigo/src/Kconfig.projbuild
```kconfig
menu "SmartFlora Configuration"

    menu "WiFi Configuration"
        config WIFI_DEFAULT_SSID
            string "Default WiFi SSID"
            default ""
            help
                SSID of the default WiFi network to connect to

        config WIFI_DEFAULT_PASSWORD
            string "Default WiFi Password"
            default ""
            help
                Password of the default WiFi network
    endmenu



    menu "Telegram Configuration"
        config TELEGRAM_BOT_TOKEN
            string "Telegram Bot Token"
            default ""
            help
                Token for the Telegram Bot

        config TELEGRAM_CHAT_ID
            string "Telegram Chat ID"
            default ""
            help
                Chat ID for sending Telegram alerts
    endmenu

endmenu
```
