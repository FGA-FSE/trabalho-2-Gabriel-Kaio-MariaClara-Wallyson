#include "ssd1306.h"
#include "font8x8_basic.h" // A standard 8x8 font
#include <string.h>
#include "esp_log.h"
#include "freertos/FreeRTOS.h"
#include "freertos/task.h"


static const uint8_t font5x7[] = {
    0x00, 0x00, 0x00, 0x00, 0x00, // Space (0x20)
    0x00, 0x00, 0x5F, 0x00, 0x00, // !
    0x00, 0x07, 0x00, 0x07, 0x00, // "
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    0x44, 0x64, 0x54, 0x4C, 0x44  // z
};

static uint8_t buffer[SSD1306_WIDTH * SSD1306_HEIGHT / 8];
static const char *TAG = "SSD1306";

static esp_err_t i2c_write_cmd(i2c_port_t i2c_num, uint8_t i2c_addr, uint8_t cmd) {
    uint8_t write_buf[2] = {0x00, cmd};
    return i2c_master_write_to_device(i2c_num, i2c_addr, write_buf, sizeof(write_buf), pdMS_TO_TICKS(100));
}

esp_err_t ssd1306_init(i2c_port_t i2c_num, uint8_t i2c_addr) {
    esp_err_t err;
    uint8_t cmds[] = {
        0xAE, // display off
        0x20, 0x00, // memory addressing mode (horizontal)
        0x21, 0, 127, // column addr
        0x22, 0, 7, // page addr
        0xC8, // COM output scan direction
        0x40, // start line 0
        0x81, 0xCF, // contrast
        0xA1, // segment remap
        0xA6, // normal display
        0xA8, 0x3F, // multiplex ratio (64)
        0xA4, // output follows RAM content
        0xD3, 0x00, // display offset
        0xD5, 0x80, // clock divide
        0xD9, 0xF1, // pre-charge period
        0xDA, 0x12, // COM pins config
        0xDB, 0x40, // vcomh
        0x8D, 0x14, // charge pump
        0xAF  // display on
    };

    for (int i = 0; i < sizeof(cmds); i++) {
        err = i2c_write_cmd(i2c_num, i2c_addr, cmds[i]);
        if (err != ESP_OK) return err;
    }
    
    ssd1306_clear();
    return ssd1306_display(i2c_num, i2c_addr);
}

void ssd1306_clear() {
    memset(buffer, 0, sizeof(buffer));
}

esp_err_t ssd1306_display(i2c_port_t i2c_num, uint8_t i2c_addr) {
    uint8_t pkt[17];
    pkt[0] = 0x40; // Data stream
    for (int i = 0; i < sizeof(buffer); i += 16) {
        memcpy(&pkt[1], &buffer[i], 16);
        i2c_master_write_to_device(i2c_num, i2c_addr, pkt, 17, pdMS_TO_TICKS(100));
    }
    return ESP_OK;
}

static void draw_pixel(int x, int y) {
    if (x >= 0 && x < SSD1306_WIDTH && y >= 0 && y < SSD1306_HEIGHT) {
        buffer[x + (y / 8) * SSD1306_WIDTH] |= (1 << (y % 8));
    }
}

void ssd1306_draw_string(int x, int y, const char *str, int size) {
    while (*str) {
        char c = *str;
        if (c < 0x20 || c > 0x7A) c = 0x20; // Substituir por espaço
        const uint8_t *glyph = &font5x7[(c - 0x20) * 5];
        
        for (int i = 0; i < 5; i++) {
            uint8_t line = glyph[i];
            for (int j = 0; j < 8; j++) {
                if (line & 0x1) {
                    if (size == 1) {
                        draw_pixel(x + i, y + j);
                    } else if (size == 2) {
                        draw_pixel(x + i*2, y + j*2);
                        draw_pixel(x + i*2 + 1, y + j*2);
                        draw_pixel(x + i*2, y + j*2 + 1);
                        draw_pixel(x + i*2 + 1, y + j*2 + 1);
                    }
                }
                line >>= 1;
            }
        }
        x += (5 + 1) * size;
        str++;
    }
}

void ssd1306_draw_rect(int x, int y, int w, int h, bool fill) {
    for (int i = x; i < x + w; i++) {
        for (int j = y; j < y + h; j++) {
            if (fill || i == x || i == x + w - 1 || j == y || j == y + h - 1) {
                draw_pixel(i, j);
            }
        }
    }
}

void ssd1306_draw_hline(int x, int y, int w) {
    for (int i = x; i < x + w; i++) {
        draw_pixel(i, y);
    }
}

void ssd1306_draw_dot(int x, int y, bool filled) {
    if (filled) {
        draw_pixel(x, y); draw_pixel(x+1, y);
        draw_pixel(x, y+1); draw_pixel(x+1, y+1);
    } else {
        draw_pixel(x, y);
        draw_pixel(x+2, y);
        draw_pixel(x+1, y-1);
        draw_pixel(x+1, y+1);
    }
}
